## conf/machine/imx8mp-icore-ctouch2-of10.conf
```bitbake
#@TYPE: Machine
#@NAME: Boundary Devices Nitrogen8MP
#@SOC: i.MX8 MP
#@DESCRIPTION: Machine configuration for Boundary Devices Nitrogen8MP
#@MAINTAINER: Suniel Mahesh <sunil@amarulasolutions.com>

MACHINEOVERRIDES =. "mx8mp:imx-boot-container:"

IMX_DEFAULT_BSP ?= "mainline"

require conf/machine/include/imx-base.inc
require conf/machine/include/arm/armv8a/tune-cortexa53.inc

# Kernel configuration
PREFERRED_VERSION_linux-libc-headers = "5.16"
PREFERRED_PROVIDER_virtual/kernel ??= "linux-next"
KERNEL_DEVICETREE = "freescale/imx8mp-icore-mx8mp-ctouch2-of10.dtb"

KERNEL_IMAGETYPE = "Image"
RRECOMMENDS:${KERNEL_PACKAGE_NAME}-base = ""

# U-Boot configuration
PREFERRED_PROVIDER_u-boot ??= "u-boot-amarula"
PREFERRED_PROVIDER_virtual/bootloader ??= "u-boot-amarula"
SPL_BINARY = "spl/u-boot-spl.bin"
UBOOT_SUFFIX = "bin"
UBOOT_ENTRYPOINT = "0x40480000"

UBOOT_CONFIG ??= "sd"
UBOOT_CONFIG[sd]   = "imx8mp-icore-mx8mp-ctouch2_defconfig,sdcard"

UBOOT_EXTLINUX = "1"
UBOOT_EXTLINUX_LABELS  = "default"
UBOOT_EXTLINUX_DEFAULT_LABEL = "i.MX8MPLUS-iCore-Ctouch2-of10"

UBOOT_EXTLINUX_MENU_DESCRIPTION:default = "i.MX8MPLUS-iCore-Ctouch2-of10"
UBOOT_EXTLINUX_FDT:default    = "../imx8mp-icore-mx8mp-ctouch2-of10.dtb"
UBOOT_EXTLINUX_KERNEL_IMAGE ?= "../Image"
UBOOT_EXTLINUX_CONSOLE:default = "console=${console}"
UBOOT_EXTLINUX_ROOT:default  ??= "root=/dev/mmcblk1p3"

ATF_PLATFORM = "imx8mp"
ATF_LOAD_ADDR = "0x970000"

DDR_FIRMWARE_NAME = "\
    lpddr4_pmu_train_1d_imem_202006.bin \
    lpddr4_pmu_train_1d_dmem_202006.bin \
    lpddr4_pmu_train_2d_imem_202006.bin \
    lpddr4_pmu_train_2d_dmem_202006.bin \
"

IMAGE_BOOT_FILES:append = " extlinux.conf;extlinux/extlinux.conf \
                            flash.bin-${MACHINE}-sd;u-boot.${MACHINE}_sd \"

SERIAL_CONSOLES = "115200;ttymxc1"

# wic support
WKS_FILE = "imx8mp-icore-ctouch-part.wks"
IMAGE_FSTYPES = "wic.bmap wic.xz ext4.gz wic.bz2"
```

## wic/imx8mp-icore-ctouch-part.wks
```
# short-description: Create SD card image with a A/B boot partition
# long-description:
# Create an image that can be written onto a SD card using dd for use
# with i.MX8M Plus i.Core Ctouch target
# It uses u-boot
#
# The disk layout used is:
#  - - -------- ------------ -------------- ------------ ----------------------------
# | |  u-boot  |   boot_A   |   boot_B   |   rootfs_A   |   rootfs_B   |  Data       |
#  - - -------- ------------ -------------- ------------ ----------------------------
# ^ ^          ^            ^            ^              ^              ^             ^
# | |          |            |            |              |              |             |
# 0 32KiB     8MiB         8+64MiB      8+64+64MiB   136+512MiB      648+512MiB   1160+512MiB
#

part u-boot --source rawcopy --sourceparams="file=flash.bin-${MACHINE}-sd" --ondisk mmcblk0 --no-table --align 32

# Partitions boot_A, boot_B, rootfs_A, roofs_B, Data
part --source bootimg-partition --ondisk mmcblk0 --fstype=vfat --label boota --active --align 8192 --size 64M --extra-space 0
part --source bootimg-partition --ondisk mmcblk0 --fstype=vfat --label bootb --align 4096 --size 64M --extra-space 0
part / --source rootfs --ondisk mmcblk0 --fstype=ext4 --label rootfsa --align 4 --size 512
part / --source rootfs --ondisk mmcblk0 --fstype=ext4 --label rootfsb --align 4 --size 512
part --source rootfs --rootfs-dir=${IMAGE_ROOTFS}/home --ondisk mmcblk0 --fstype=ext4 --label data --align 4 --size 512
```
